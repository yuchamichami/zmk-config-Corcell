## Kconfig
```kconfig
if ZMK_POINTING

config ZMK_INPUT_PROCESSOR_VERTICAL_SCROLL
    bool "Vertical-only scroll input processor"
    default y
    depends on DT_HAS_ZMK_INPUT_PROCESSOR_VERTICAL_SCROLL_ENABLED

endif

DT_COMPAT_CORCELL_BATTERY_VOLTAGE_DIVIDER := corcell,battery-voltage-divider

config CORCELL_BATTERY_VOLTAGE_DIVIDER
    bool
    default $(dt_compat_enabled,$(DT_COMPAT_CORCELL_BATTERY_VOLTAGE_DIVIDER))
    select ADC
    select ZMK_BATTERY
    depends on SENSOR
    help
        Enable Corcell dry-cell voltage divider battery monitoring.

config CORCELL_POWER_ON_LED
    bool "Light the XIAO LED at power-on"
    default y
    depends on GPIO
    help
        Light the XIAO's green LED for a moment whenever the board powers
        up, then release the pin. Inserting a dry cell makes the LED
        flash, which tells you during assembly that the cell and the
        boost converter are alive without pairing the keyboard first.

config CORCELL_POWER_ON_LED_MS
    int "Power-on LED duration in milliseconds"
    default 2000
    range 100 10000
    depends on CORCELL_POWER_ON_LED
    help
        How long the power-on LED stays lit. The pin is disconnected
        afterwards, so this costs nothing once the LED goes dark.
```

## boards/shields/Corchibi2_trackpad_debug/Kconfig.defconfig
```kconfig
if SHIELD_CORCHIBI2_R_TRACKPAD_DEBUG

config ZMK_KEYBOARD_NAME
    default "Corchibi2 TPDBG"

config ZMK_SPLIT
    default y

config ZMK_SPLIT_ROLE_CENTRAL
    default y

endif
```

## boards/shields/Corchibi2_trackpad_debug/Kconfig.shield
```kconfig
config SHIELD_CORCHIBI2_R_TRACKPAD_DEBUG
    def_bool $(shields_list_contains,Corchibi2_R_trackpad_debug)
```

## boards/shields/Corchibi2_twist_debug/Kconfig.defconfig
```kconfig
if SHIELD_CORCHIBI2_R_TWIST_DEBUG

config ZMK_KEYBOARD_NAME
    default "Corchibi2 DBG"

config ZMK_SPLIT
    default y

config ZMK_SPLIT_ROLE_CENTRAL
    default y

endif
```

## boards/shields/Corchibi2_twist_debug/Kconfig.shield
```kconfig
config SHIELD_CORCHIBI2_R_TWIST_DEBUG
    def_bool $(shields_list_contains,Corchibi2_R_twist_debug)
```

## boards/shields/Corell/Kconfig.defconfig
```kconfig
if SHIELD_CORELL_R

config ZMK_KEYBOARD_NAME
    default "Corell"

config ZMK_SPLIT
    default y

config ZMK_SPLIT_ROLE_CENTRAL
    default y

endif

if SHIELD_CORELL_L

config ZMK_KEYBOARD_NAME
    default "Corell"

config ZMK_SPLIT
    default y

endif
```

## boards/shields/Corell/Kconfig.shield
```kconfig
config SHIELD_CORELL_R
    def_bool $(shields_list_contains,Corell_R)

config SHIELD_CORELL_L
    def_bool $(shields_list_contains,Corell_L)
```

## boards/shields/Corell_trackpad_debug/Kconfig.defconfig
```kconfig
if SHIELD_CORELL_R_TRACKPAD_DEBUG

config ZMK_KEYBOARD_NAME
    default "Corell TPDBG"

config ZMK_SPLIT
    default y

config ZMK_SPLIT_ROLE_CENTRAL
    default y

endif
```

## boards/shields/Corell_trackpad_debug/Kconfig.shield
```kconfig
config SHIELD_CORELL_R_TRACKPAD_DEBUG
    def_bool $(shields_list_contains,Corell_R_trackpad_debug)
```

## boards/shields/Corell_twist_debug/Kconfig.defconfig
```kconfig
if SHIELD_CORELL_R_TWIST_DEBUG

config ZMK_KEYBOARD_NAME
    default "Corell DBG"

config ZMK_SPLIT
    default y

config ZMK_SPLIT_ROLE_CENTRAL
    default y

endif
```

## boards/shields/Corell_twist_debug/Kconfig.shield
```kconfig
config SHIELD_CORELL_R_TWIST_DEBUG
    def_bool $(shields_list_contains,Corell_R_twist_debug)
```

## config/west.yml
```yaml
manifest:
  version: 1.2
  defaults:
    remote: cormoran
    revision: main
  remotes:
    - name: cormoran
      url-base: https://github.com/cormoran
    - name: zmkfirmware
      url-base: https://github.com/zmkfirmware
    - name: sekigon-gonnoc
      url-base: https://github.com/sekigon-gonnoc
    - name: yuchamichami
      url-base: https://github.com/yuchamichami
  projects:
    - name: zmk-west-commands
      import: true
    # Fork of sekigon-gonnoc/zmk-driver-paw3222. The only change is dropping
    # the power-down write on suspend: waking from soft-off is a reset, the
    # sensor keeps its supply across it, and with NCS strapped to GND nothing
    # can bring it back out of power-down short of pulling the cell.
    - name: zmk-driver-paw3222
      remote: yuchamichami
      revision: fc946760e7f870e512be8fce7a26cc5c004a8663
    - name: zmk-module-ble-management
    - name: zmk-feature-custom-settings
    - name: zmk-module-runtime-input-processor
    - name: zmk-module-settings-rpc
    - name: zmk-feature-input-stream
    - name: zmk-feature-module-physical-layout
    - name: zmk-feature-runtime-combo
      import: true
    - name: zmk-feature-runtime-macro
      import: true
    - name: zmk-feature-fast-keymap
    - name: zmk-feature-device-info
    - name: zmk-feature-kscan-diagnostics
      import: true
    - name: zmk-feature-watchdog
      import: true
    - name: zmk-feature-zephyr-setting-expose
    - name: zmk
      revision: main+dya
      import:
        file: app/west.yml
    - name: zephyr
      revision: v4.1.0+zmk-fixes+nrf-half-duplex-uart
      clone-depth: 1
      import:
        name-blocklist:
          - ci-tools
          - hal_altera
          - hal_cypress
          - hal_infineon
          - hal_microchip
          - hal_nxp
          - hal_openisa
          - hal_silabs
          - hal_xtensa
          - hal_st
          - hal_ti
          - loramac-node
          - mcuboot
          - mcumgr
          - net-tools
          - openthread
          - edtt
          - trusted-firmware-m
  self:
    path: config
```

## dts/bindings/input_processors/zmk,input-processor-event-debug.yaml
```yaml
# Copyright (c) 2026
# SPDX-License-Identifier: MIT

description: Input processor that logs input events without modifying them

compatible: "zmk,input-processor-event-debug"

include: ip_zero_param.yaml

properties:
  min-interval-ms:
    type: int
    default: 0
    description: Minimum time between log lines. Use 0 to log every event.
```

## dts/bindings/input_processors/zmk,input-processor-motion-debug.yaml
```yaml
# Copyright (c) 2026
# SPDX-License-Identifier: MIT

description: Input processor that logs raw relative X/Y motion without modifying events

compatible: "zmk,input-processor-motion-debug"

include: ip_zero_param.yaml

properties:
  type:
    type: int

  min-interval-ms:
    type: int
    default: 0
    description: Minimum time between log lines. Use 0 to log every synced motion report.

  log-zero:
    type: boolean
    description: Also log reports whose accumulated X and Y are both zero.
```

## dts/bindings/sensor/corell,battery-voltage-divider.yaml
```yaml
# Copyright (c) 2020 The ZMK Contributors
# Copyright (c) 2026 The Corell contributors
# SPDX-License-Identifier: MIT

description: Corell dry-cell battery SoC monitoring using a voltage divider

compatible: "corell,battery-voltage-divider"

include: voltage-divider.yaml

properties:
  mv-to-pct-thresholds:
    type: array
    required: true
    description: |
      Battery millivolt thresholds for 0%, 10%, ... 100% state-of-charge
      mapping.
```
